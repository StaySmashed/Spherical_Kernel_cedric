## drivers/cpufreq/Kconfig
```kconfig
menu "CPU Frequency scaling"

config CPU_FREQ
	bool "CPU Frequency scaling"
	help
	  CPU Frequency scaling allows you to change the clock speed of
	  CPUs on the fly. This is a nice method to save power, because
	  the lower the CPU clock speed, the less power the CPU consumes.

	  Note that this driver doesn't automatically change the CPU
	  clock speed, you need to either enable a dynamic cpufreq governor
	  (see below) after boot, or use a userspace tool.

	  For details, take a look at <file:Documentation/cpu-freq>.

	  If in doubt, say N.

if CPU_FREQ

config CPU_FREQ_GOV_COMMON
	bool

config CPU_FREQ_BOOST_SW
	bool
	depends on THERMAL

config SCHED_FREQ_INPUT
	bool "Scheduler inputs to cpufreq governor"
	depends on SCHED_HMP
	help
	  This option enables support for scheduler based CPU utilization
	  calculations which may then be used by any cpufreq governor. The
	  scheduler keeps track of "recent" cpu demand of tasks, which can
	  help determine need for changing frequency well in advance of what
	  a governor would have been able to detect on its own.

config CPU_FREQ_STAT
	tristate "CPU frequency translation statistics"
	default y
	help
	  This driver exports CPU frequency statistics information through sysfs
	  file system.

	  To compile this driver as a module, choose M here: the
	  module will be called cpufreq_stats.

	  If in doubt, say N.

config CPU_FREQ_STAT_DETAILS
	bool "CPU frequency translation statistics details"
	depends on CPU_FREQ_STAT
	help
	  This will show detail CPU frequency translation table in sysfs file
	  system.

	  If in doubt, say N.

choice
	prompt "Default CPUFreq governor"
	default CPU_FREQ_DEFAULT_GOV_USERSPACE if ARM_SA1100_CPUFREQ || ARM_SA1110_CPUFREQ
	default CPU_FREQ_DEFAULT_GOV_PERFORMANCE
	help
	  This option sets which CPUFreq governor shall be loaded at
	  startup. If in doubt, select 'performance'.

config CPU_FREQ_DEFAULT_GOV_PERFORMANCE
	bool "performance"
	select CPU_FREQ_GOV_PERFORMANCE
	help
	  Use the CPUFreq governor 'performance' as default. This sets
	  the frequency statically to the highest frequency supported by
	  the CPU.

config CPU_FREQ_DEFAULT_GOV_ADAPTIVE
	bool "adaptive"
	select CPU_FREQ_GOV_ADAPTIVE
	select CPU_FREQ_GOV_PERFORMANCE
	help
	  This driver adds a dynamic cpufreq policy governor
	  designed for latency-sensitive workloads and also for demanding
	  performance.
	  This governor attempts to reduce the latency of clock
	  increases so that the system is more responsive to
	  interactive workloads in loweset steady-state but to
	  to reduce power consumption in middle operation level level up
	  will be done in step by step to prohibit system from going to
	  max operation level.

config CPU_FREQ_DEFAULT_GOV_HYPER
	bool "hyper"
	select CPU_FREQ_GOV_HYPER
	select CPU_FREQ_GOV_PERFORMANCE
	help
	  This driver is similar to smartassV2. More aggressive ramping,
	  so more performance, less battery.

config CPU_FREQ_DEFAULT_GOV_LIONHEART
	bool "lionheart"
	select CPU_FREQ_GOV_LIONHEART
	select CPU_FREQ_GOV_PERFORMANCE
	help
	  Intellidemand aka Intelligent Ondemand from Faux is yet another governor that's based on ondemand. Unlike 		  what some users believe, this governor is not the replacement for OC Daemon (Having different governors for 		  sleep and awake). The original intellidemand behaves differently according to GPU usage. When GPU is really 		  busy (gaming, maps, benchmarking, etc) intellidemand behaves like ondemand. When GPU is 'idling' (or 		  moderately busy), intellidemand limits max frequency to a step depending on frequencies available in your 		  device/kernel for saving battery. This is called browsing mode. We can see some 'traces' of interactive 		  governor here. Frequency scale-up decision is made based on idling time of CPU. Lower idling time (<20%) 		  causes CPU to scale-up from current frequency. Frequency scale-down happens at steps=5% of max frequency. 		  (This parameter is tunable only in conservative, among the popular governors)
	  To sum up, this is an intelligent ondemand that enters browsing mode to limit max frequency when GPU is 		  idling, and (exits browsing mode) behaves like ondemand when GPU is busy; to deliver performance for gaming 	 	  and such. Intellidemand does not jump to highest frequency when screen is off.

config CPU_FREQ_DEFAULT_GOV_LULZACTIVE
	bool "lulzactive"
	select CPU_FREQ_GOV_LULZACTIVE
	select CPU_FREQ_GOV_PERFORMANCE
	help
	  This new find from Tegrak is based on Interactive & Smartass governors and is one of the favorites.
	  Old Version: When workload is greater than or equal to 60%, the governor scales up CPU to next higher step. 		  When workload is less than 60%, governor scales down CPU to next lower step. When screen is off, frequency is 	  locked to global scaling minimum frequency.
	  New Version: Three more user configurable parameters: inc_cpu_load, pump_up_step, pump_down_step. Unlike 		  older version, this one gives more control for the user. We can set the threshold at which governor decides 		  to scale up/down. We can also set number of frequency steps to be skipped while polling up and down.
	  When workload greater than or equal to inc_cpu_load, governor scales CPU pump_up_step steps up. When workload 	  is less than inc_cpu_load, governor scales CPU down pump_down_step steps down.

config CPU_FREQ_DEFAULT_GOV_SMARTASS2
	bool "smartass2"
	select CPU_FREQ_GOV_SMARTASS2
	select CPU_FREQ_GOV_PERFORMANCE
	help
	  Version 2 of the original smartass governor from Erasmux. Another favorite for many a people. The governor 		  aim for an "ideal frequency", and ramp up more aggressively towards this freq and less aggressive after. It 		  uses different ideal frequencies for screen on and screen off, namely awake_ideal_freq and sleep_ideal_freq. 		  This governor scales down CPU very fast (to hit sleep_ideal_freq soon) while screen is off and scales up 		  rapidly to awake_ideal_freq (500 mhz for GS2 by default) when screen is on. There's no upper limit for 		  frequency while screen is off (unlike Smartass). So the entire frequency range is available for the governor 		  to use during screen-on and screen-off state. The motto of this governor is a balance between performance and 	  battery.

config CPU_FREQ_DEFAULT_GOV_POWERSAVE
	bool "powersave"
	depends on EXPERT
	select CPU_FREQ_GOV_POWERSAVE
	help
	  Use the CPUFreq governor 'powersave' as default. This sets
	  the frequency statically to the lowest frequency supported by
	  the CPU.

config CPU_FREQ_DEFAULT_GOV_USERSPACE
	bool "userspace"
	select CPU_FREQ_GOV_USERSPACE
	help
	  Use the CPUFreq governor 'userspace' as default. This allows
	  you to set the CPU frequency manually or when a userspace
	  program shall be able to set the CPU dynamically without having
	  to enable the userspace governor manually.

config CPU_FREQ_DEFAULT_GOV_ONDEMAND
	bool "ondemand"
	select CPU_FREQ_GOV_ONDEMAND
	select CPU_FREQ_GOV_PERFORMANCE
	help
	  Use the CPUFreq governor 'ondemand' as default. This allows
	  you to get a full dynamic frequency capable system by simply
	  loading your cpufreq low-level hardware driver.
	  Be aware that not all cpufreq drivers support the ondemand
	  governor. If unsure have a look at the help section of the
	  driver. Fallback governor will be the performance governor.

config CPU_FREQ_DEFAULT_GOV_ONDEMANDX
	bool "ondemandx"
	select CPU_FREQ_GOV_ONDEMANDX
	select CPU_FREQ_GOV_PERFORMANCE
	help
	  Basically an ondemand with suspend/wake profiles. This governor is supposed to be a battery
	  friendly ondemand. When screen is off, max frequency is capped at 500 mhz. Even though
	  ondemand is the default governor in many kernel and is considered safe/stable, the support
	  for ondemand/ondemandX depends on CPU
	  capability to do fast frequency switching which are very low latency frequency transitions.
	  I have read somewhere that the performance of ondemand/ondemandx were significantly varying
	  for different i/o schedulers.  This is not true for most of the other governors. I personally
	  feel ondemand/ondemandx goes best with SIO I/O scheduler.

config CPU_FREQ_DEFAULT_GOV_CONSERVATIVE
	bool "conservative"
	select CPU_FREQ_GOV_CONSERVATIVE
	select CPU_FREQ_GOV_PERFORMANCE
	help
	  Use the CPUFreq governor 'conservative' as default. This allows
	  you to get a full dynamic frequency capable system by simply
	  loading your cpufreq low-level hardware driver.
	  Be aware that not all cpufreq drivers support the conservative
	  governor. If unsure have a look at the help section of the
	  driver. Fallback governor will be the performance governor.

config CPU_FREQ_DEFAULT_GOV_INTERACTIVE
	bool "interactive"
	select CPU_FREQ_GOV_INTERACTIVE
	help
	  Use the CPUFreq governor 'interactive' as default. This allows
	  you to get a full dynamic cpu frequency capable system by simply
	  loading your cpufreq low-level hardware driver, using the
	  'interactive' governor for latency-sensitive workloads.

endchoice

config CPU_FREQ_GOV_PERFORMANCE
	tristate "'performance' governor"
	help
	  This cpufreq governor sets the frequency statically to the
	  highest available CPU frequency.

	  To compile this driver as a module, choose M here: the
	  module will be called cpufreq_performance.

	  If in doubt, say Y.

config CPU_FREQ_GOV_ADAPTIVE
	tristate "'adaptive' governor"
	help
	  This driver adds a dynamic cpufreq policy governor
	  designed for latency-sensitive workloads and also for demanding
	  performance.
	  This governor attempts to reduce the latency of clock
	  increases so that the system is more responsive to
	  interactive workloads in loweset steady-state but to
	  to reduce power consumption in middle operation level level up
	  will be done in step by step to prohibit system from going to
	  max operation level.

	  To compile this driver as a module, choose M here: the
	  module will be called cpufreq_adaptive.

	  For details, take a look at linux/Documentation/cpu-freq.

	  If in doubt, say N.

config CPU_FREQ_GOV_HYPER
	tristate "'hyper' governor"
	help
	  This driver is similar to smartassV2. More aggressive ramping,
	  so more performance, less battery.

	  To compile this driver as a module, choose M here: the
	  module will be called cpufreq_hyper.

	  For details, take a look at linux/Documentation/cpu-freq.

	  If in doubt, say N.

config CPU_FREQ_GOV_LIONHEART
	tristate "'lionheart' governor"
	help
	  Lionheart is a conservative-based governor which is based on samsung's update3 source.
	  The tunables (such as the thresholds and sampling rate) were changed so the governor behaves
	  more like the performance one, at the cost of battery as the scaling is very aggressive.

	  To compile this driver as a module, choose M here: the
	  module will be called cpufreq_lionheart.

	  For details, take a look at linux/Documentation/cpu-freq.

	  If in doubt, say N.

config CPU_FREQ_GOV_LULZACTIVE
	tristate "'lulzactive' governor"
	help
	  This new find from Tegrak is based on Interactive & Smartass governors and is one of the
	  favorites.
	  Old Version: When workload is greater than or equal to 60%, the governor scales up CPU to
	  next higher step.  When workload is less than 60%, governor scales down CPU to next lower
	  step. When screen is off, frequency is locked to global scaling minimum frequency.
	  New Version: Three more user configurable parameters: inc_cpu_load, pump_up_step,
	  pump_down_step. Unlike older version, this one gives more control for the user. We can
	  set the threshold at which governor decides to scale up/down. We can also set number of
	  frequency steps to be skipped while polling up and down.  When workload greater than or
	  equal to inc_cpu_load, governor scales CPU pump_up_step steps up. When workload is less
	  than inc_cpu_load, governor scales CPU down pump_down_step steps down.

	  To compile this driver as a module, choose M here: the
	  module will be called cpufreq_lulzactive.

	  For details, take a look at linux/Documentation/cpu-freq.

	  If in doubt, say N.

config CPU_FREQ_GOV_SMARTASS2
	tristate "'smartass2' governor"
	help
	  Version 2 of the original smartass governor from Erasmux. Another favorite for many a people.
	  The governor aim for an "ideal frequency", and ramp up more aggressively towards this freq
	  and less aggressive after. It uses different ideal frequencies for screen on and screen off,
	  namely awake_ideal_freq and sleep_ideal_freq. This governor scales down CPU very
	  fast (to hit sleep_ideal_freq soon) while screen is off and scales up rapidly to
	  awake_ideal_freq (500 mhz for GS2 by default) when screen is on. There's no upper limit for
	  frequency while screen is off (unlike Smartass). So the entire frequency range is available
	  for the governor to use during screen-on and screen-off state. The motto of this
	  governor is a balance between performance and battery.

	  To compile this driver as a module, choose M here: the
	  module will be called cpufreq_smartass2.

	  For details, take a look at linux/Documentation/cpu-freq.

	  If in doubt, say N.

config CPU_FREQ_GOV_POWERSAVE
	tristate "'powersave' governor"
	help
	  This cpufreq governor sets the frequency statically to the
	  lowest available CPU frequency.

	  To compile this driver as a module, choose M here: the
	  module will be called cpufreq_powersave.

	  If in doubt, say Y.

config CPU_FREQ_GOV_USERSPACE
	tristate "'userspace' governor for userspace frequency scaling"
	help
	  Enable this cpufreq governor when you either want to set the
	  CPU frequency manually or when a userspace program shall
	  be able to set the CPU dynamically, like on LART
	  <http://www.lartmaker.nl/>.

	  To compile this driver as a module, choose M here: the
	  module will be called cpufreq_userspace.

	  For details, take a look at <file:Documentation/cpu-freq/>.

	  If in doubt, say Y.

config CPU_FREQ_GOV_ONDEMAND
	tristate "'ondemand' cpufreq policy governor"
	select CPU_FREQ_GOV_COMMON
	help
	  'ondemand' - This driver adds a dynamic cpufreq policy governor.
	  The governor does a periodic polling and
	  changes frequency based on the CPU utilization.
	  The support for this governor depends on CPU capability to
	  do fast frequency switching (i.e, very low latency frequency
	  transitions).

	  To compile this driver as a module, choose M here: the
	  module will be called cpufreq_ondemand.

	  For details, take a look at linux/Documentation/cpu-freq.

	  If in doubt, say N.

config CPU_FREQ_GOV_ONDEMANDX
	tristate "'ondemandx' cpufreq policy governor"
	select CPU_FREQ_TABLE
	help
	  This driver adds a dynamic cpufreq policy governor.
	  The governor does a periodic polling and
	  changes frequency based on the CPU utilization.
	  The support for this governor depends on CPU capability to
	  do fast frequency switching (i.e, very low latency frequency
	  transitions).

	  To compile this driver as a module, choose M here: the
	  module will be called cpufreq_ondemand.

	  For details, take a look at linux/Documentation/cpu-freq.

	  If in doubt, say N.

config CPU_FREQ_GOV_INTERACTIVE
	tristate "'interactive' cpufreq policy governor"
	help
	  'interactive' - This driver adds a dynamic cpufreq policy governor
	  designed for latency-sensitive workloads.

	  This governor attempts to reduce the latency of clock
	  increases so that the system is more responsive to
	  interactive workloads.

	  To compile this driver as a module, choose M here: the
	  module will be called cpufreq_interactive.

	  For details, take a look at linux/Documentation/cpu-freq.

	  If in doubt, say N.

config CPU_FREQ_GOV_CONSERVATIVE
	tristate "'conservative' cpufreq governor"
	depends on CPU_FREQ
	select CPU_FREQ_GOV_COMMON
	help
	  'conservative' - this driver is rather similar to the 'ondemand'
	  governor both in its source code and its purpose, the difference is
	  its optimisation for better suitability in a battery powered
	  environment.  The frequency is gracefully increased and decreased
	  rather than jumping to 100% when speed is required.

	  If you have a desktop machine then you should really be considering
	  the 'ondemand' governor instead, however if you are using a laptop,
	  PDA or even an AMD64 based computer (due to the unacceptable
	  step-by-step latency issues between the minimum and maximum frequency
	  transitions in the CPU) you will probably want to use this governor.

	  To compile this driver as a module, choose M here: the
	  module will be called cpufreq_conservative.

	  For details, take a look at linux/Documentation/cpu-freq.

	  If in doubt, say N.

config CPUFREQ_DT
	tristate "Generic DT based cpufreq driver"
	depends on HAVE_CLK && OF
	# if CPU_THERMAL is on and THERMAL=m, CPUFREQ_DT cannot be =y:
	depends on !CPU_THERMAL || THERMAL
	select PM_OPP
	help
	  This adds a generic DT based cpufreq driver for frequency management.
	  It supports both uniprocessor (UP) and symmetric multiprocessor (SMP)
	  systems which share clock and voltage across all CPUs.

	  If in doubt, say N.

config CPU_BOOST
	tristate "Event base short term CPU freq boost"
	depends on CPU_FREQ
	help
	  This driver boosts the frequency of one or more CPUs based on
	  various events that might occur in the system. As of now, the
	  events it reacts to are:
	  - Migration of important threads from one CPU to another.

	  If in doubt, say N.

menu "x86 CPU frequency scaling drivers"
depends on X86
source "drivers/cpufreq/Kconfig.x86"
endmenu

menu "ARM CPU frequency scaling drivers"
depends on ARM || ARM64
source "drivers/cpufreq/Kconfig.arm"
endmenu

menu "AVR32 CPU frequency scaling drivers"
depends on AVR32

config AVR32_AT32AP_CPUFREQ
	bool "CPU frequency driver for AT32AP"
	depends on PLATFORM_AT32AP
	default n
	help
	  This enables the CPU frequency driver for AT32AP processors.
	  If in doubt, say N.

endmenu

menu "CPUFreq processor drivers"
depends on IA64

config IA64_ACPI_CPUFREQ
	tristate "ACPI Processor P-States driver"
	depends on ACPI_PROCESSOR
	help
	This driver adds a CPUFreq driver which utilizes the ACPI
	Processor Performance States.

	For details, take a look at <file:Documentation/cpu-freq/>.

	If in doubt, say N.

endmenu

menu "MIPS CPUFreq processor drivers"
depends on MIPS

config LOONGSON2_CPUFREQ
	tristate "Loongson2 CPUFreq Driver"
	help
	  This option adds a CPUFreq driver for loongson processors which
	  support software configurable cpu frequency.

	  Loongson2F and it's successors support this feature.

	  For details, take a look at <file:Documentation/cpu-freq/>.

	  If in doubt, say N.

endmenu

menu "PowerPC CPU frequency scaling drivers"
depends on PPC32 || PPC64
source "drivers/cpufreq/Kconfig.powerpc"
endmenu

menu "SPARC CPU frequency scaling drivers"
depends on SPARC64
config SPARC_US3_CPUFREQ
	tristate "UltraSPARC-III CPU Frequency driver"
	help
	  This adds the CPUFreq driver for UltraSPARC-III processors.

	  For details, take a look at <file:Documentation/cpu-freq>.

	  If in doubt, say N.

config SPARC_US2E_CPUFREQ
	tristate "UltraSPARC-IIe CPU Frequency driver"
	help
	  This adds the CPUFreq driver for UltraSPARC-IIe processors.

	  For details, take a look at <file:Documentation/cpu-freq>.

	  If in doubt, say N.
endmenu

menu "SH CPU Frequency scaling"
depends on SUPERH
config SH_CPU_FREQ
	tristate "SuperH CPU Frequency driver"
	help
	  This adds the cpufreq driver for SuperH. Any CPU that supports
	  clock rate rounding through the clock framework can use this
	  driver. While it will make the kernel slightly larger, this is
	  harmless for CPUs that don't support rate rounding. The driver
	  will also generate a notice in the boot log before disabling
	  itself if the CPU in question is not capable of rate rounding.

	  For details, take a look at <file:Documentation/cpu-freq>.

	  If unsure, say N.
endmenu

endif
endmenu
```
